/dts-v1/;
/plugin/;
/ {
    compatible = "allwinner,sun50i-h616";
    fragment@0 {
        target = <&i2c1>;
        __overlay__ {
            ina219@40 {
		compatible = "ti,ina219";
		reg = <0x40>;
		shunt-resistor = <100000>; // 0.10 Ω = 100000 µΩ (R100)
		// ti,shunt-gain = <8>;
	    };
        };
    };
}; 
